## fit_uImage.its
```
/*
 * U-Boot uImage source file for "X project"
 */

/dts-v1/;

/ {
	description = "U-Boot uImage source file for X project";
	#address-cells = <1>;

	images {
		kernel@arm64 {
			description = "Unify(TODO) ARM64 Linux kernel";
			data = /incbin/("./out/linux/arch/arm64/boot/Image");
			type = "kernel";
			arch = "arm";
			os = "linux";
			compression = "none";
			load = <0x00080000>;
			entry = <0x00080000>;
			hash@1 {
				algo = "crc32";
			};
			hash@2 {
				algo = "sha1";
			};
		};
		fdt@bubblegum96 {
			description = "Flattened Device Tree blob for Bubblegum-96";
			data = /incbin/("./out/linux/arch/arm64/boot/dts/actions/s900-bubblegum.dtb");
			type = "flat_dt";
			arch = "arm";
			compression = "none";
			hash@1 {
				algo = "crc32";
			};
			hash@2 {
				algo = "sha1";
			};
		};
	};

	configurations {
		default = "conf@bubblegum96";
		conf@bubblegum96 {
			description = "Boot Linux kernel with FDT blob";
			kernel = "kernel@arm64";
			fdt = "fdt@bubblegum96";
		};
	};
};
```

## its/fit_uImage_bubblegum.its
```
/*
 * U-Boot uImage source file for "X project"
 */
#include "xprj_config.h"

/dts-v1/;

/ {
	description = "U-Boot uImage source file for X project";
	#address-cells = <1>;

	images {
		kernel@arm64 {
			description = "Unify ARM64 Linux kernel";
			data = /incbin/("../out/linux/arch/arm64/boot/Image");
			type = "kernel";
			arch = XC_BOARD_ARCH;
			os = "linux";
			compression = "none";
			load = <XC_KERNEL_LOAD_ADDR>;
			entry = <XC_KERNEL_ENTRY_ADDR>;
		};
	#if XC_DTB_ENABLE
		fdt@bubblegum96 {
			description = "Flattened Device Tree blob for Bubblegum-96";
			data = /incbin/("../out/linux/arch/arm64/boot/dts/actions/s900-bubblegum.dtb");
			type = "flat_dt";
			arch = XC_BOARD_ARCH;
			compression = "none";
		};
	#endif
		initramfs@bubblegum96 {
			description = "initramfs for Bubblegum-96";
			data = /incbin/("../out/initramfs.gz");
			type = "ramdisk";
			arch = XC_BOARD_ARCH;
			os = "linux";
			compression = "gzip";
			load = <00000000>;
			entry = <00000000>;
		};
	};

	configurations {
		default = "conf@bubblegum96";
		conf@bubblegum96 {
			description = "Boot Linux kernel with FDT blob";
			kernel = "kernel@arm64";
		#if XC_DTB_ENABLE
			fdt = "fdt@bubblegum96";
		#endif
			ramdisk = "initramfs@bubblegum96";
		};
	};
};
```

## its/fit_uImage_tiny210.its
```
/*
 * U-Boot uImage source file for "X project"
 */

#include "xprj_config.h"

/dts-v1/;

/ {
	description = "U-Boot uImage source file for X project";
	#address-cells = <1>;

	images {
		kernel@tiny210 {
			description = "tiny210 ARM Linux kernel";
			data = /incbin/("../out/linux/arch/arm/boot/zImage");
			type = "kernel";
			arch = "arm";
			os = "linux";
			compression = "none";
			load = <XC_KERNEL_LOAD_ADDR>;
			entry = <XC_KERNEL_ENTRY_ADDR>;
		};
	#if XC_DTB_ENABLE
		fdt@tiny210 {
			description = "Flattened Device Tree blob for tiny210";
			data = /incbin/("../out/linux/arch/arm/boot/dts/s5pv210-tiny210.dtb");
			type = "flat_dt";
			arch = "arm";
			compression = "none";
		};
	#endif

	#if XC_INITRAMFS_ENABLE
                initramfs@tiny210 {
                        description = "initramfs for tiny210";
                        data = /incbin/("../out/initramfs.gz");
                        type = "ramdisk";
                        arch = XC_BOARD_ARCH;
                        os = "linux";
                        compression = "gzip";
                        load = <00000000>;
                        entry = <00000000>;
                };
	#endif
	};

	configurations {
		default = "conf@tiny210";
		conf@tiny210 {
			description = "Boot Linux kernel with FDT blob";
			kernel = "kernel@tiny210";
	#if XC_DTB_ENABLE
			fdt = "fdt@tiny210";
	#endif
	#if XC_INITRAMFS_ENABLE
			ramdisk = "initramfs@tiny210";
	#endif
		};
	};
};
```

## script/fit_uImage_bubblegum.its
```
/*
 * U-Boot uImage source file for "X project"
 */

/dts-v1/;

/ {
	description = "U-Boot uImage source file for X project";
	#address-cells = <1>;

	images {
		kernel@arm64 {
			description = "Unify ARM64 Linux kernel";
			data = /incbin/("../out/linux/arch/arm64/boot/Image");
			type = "kernel";
			arch = "arm64";
			os = "linux";
			compression = "none";
			load = <0x00080000>;
			entry = <0x00080000>;
		};
		fdt@bubblegum96 {
			description = "Flattened Device Tree blob for Bubblegum-96";
			data = /incbin/("../out/linux/arch/arm64/boot/dts/actions/s900-bubblegum.dtb");
			type = "flat_dt";
			arch = "arm64";
			compression = "none";
		};
	};

	configurations {
		default = "conf@bubblegum96";
		conf@bubblegum96 {
			description = "Boot Linux kernel with FDT blob";
			kernel = "kernel@arm64";
			fdt = "fdt@bubblegum96";
		};
	};
};
```

## script/fit_uImage_tiny210.its
```
/*
 * U-Boot uImage source file for "X project"
 */

/dts-v1/;

/ {
	description = "U-Boot uImage source file for X project";
	#address-cells = <1>;

	images {
		kernel@tiny210 {
			description = "tiny210 ARM Linux kernel";
			data = /incbin/("../out/linux/arch/arm/boot/zImage");
			type = "kernel";
			arch = "arm";
			os = "linux";
			compression = "none";
			load = <0x20080000>;
			entry = <0x20080040>;
		};
		fdt@tiny210 {
			description = "Flattened Device Tree blob for tiny210";
			data = /incbin/("../out/linux/arch/arm/boot/dts/s5pv210-tiny210.dtb");
			type = "flat_dt";
			arch = "arm64";
			compression = "none";
		};
	};

	configurations {
		default = "conf@tiny210";
		conf@tiny210 {
			description = "Boot Linux kernel with FDT blob";
			kernel = "kernel@tiny210";
			fdt = "fdt@tiny210";
		};
	};
};
```
